
#include <string.h>
#include <avr/io.h>
#include <avr/pgmspace.h>

#include "aes.h"


const unsigned char E[] = {
	0x2b,0x7e,0x15,0x16,0x28,0xae,0xd2,0xa6,0xab,0xf7,0x15,0x88,0x09,0xcf,0x4f,0x3c,0xa0,0xfa,0xfe,0x17,0x88,0x54,0x2c,
	0xb1,0x23,0xa3,0x39,0x39,0x2a,0x6c,0x76,0x05,0xf2,0xc2,0x95,0xf2,0x7a,0x96,0xb9,0x43,0x59,0x35,0x80,0x7a,0x73,0x59,
	0xf6,0x7f,0x3d,0x80,0x47,0x7d,0x47,0x16,0xfe,0x3e,0x1e,0x23,0x7e,0x44,0x6d,0x7a,0x88,0x3b,0xef,0x44,0xa5,0x41,0xa8,
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	0x14,0xf9,0xa8,0xc9,0xee,0x25,0x89,0xe1,0x3f,0x0c,0xc8,0xb6,0x63,0x0c,0xa6,
};

const unsigned char EP[] = {
	0x2b,0x7e,0x15,0x16,0x28,0xae,0xd2,0xa6,0xab,0xf7,0x15,0x88,0x09,0xcf,0x4f,0x3c,0x2b,0x37,0x08,0xa7,0xf2,0x62,0xd4,
	0x05,0xbc,0x3e,0xbd,0xbf,0x4b,0x61,0x7d,0x62,0xcc,0x75,0x05,0xeb,0x3e,0x17,0xd1,0xee,0x82,0x29,0x6c,0x51,0xc9,0x48,
	0x11,0x33,0x7c,0x1f,0x13,0xf7,0x42,0x08,0xc2,0x19,0xc0,0x21,0xae,0x48,0x09,0x69,0xbf,0x7b,0x90,0x88,0x44,0x13,0xd2,
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	0x14,0xf9,0xa8,0xc9,0xee,0x25,0x89,0xe1,0x3f,0x0c,0xc8,0xb6,0x63,0x0c,0xa6,
};

const unsigned char K[] = {0x2b,0x7e,0x15,0x16,0x28,0xae,0xd2,0xa6,0xab,0xf7,0x15,0x88,0x09,0xcf,0x4f,0x3c};
#if AES_IMPLEMENTATION == 0
const unsigned char IK[] = {0x47,0xea,0xdd,0xe6,0x8e,0x04,0xf8,0x6f,0x6f,0x3b,0xf4,0xa7,0xd9,0x58,0xf8,0x01};
#else
const unsigned char IK[] = {0xd0,0x14,0xf9,0xa8,0xc9,0xee,0x25,0x89,0xe1,0x3f,0x0c,0xc8,0xb6,0x63,0x0c,0xa6};
#endif
const unsigned char plain[] = {0x32,0x43,0xf6,0xa8,0x88,0x5a,0x30,0x8d,0x31,0x31,0x98,0xa2,0xe0,0x37,0x07,0x34};
const unsigned char cipher[] = {0x39,0x25,0x84,0x1d,0x02,0xdc,0x09,0xfb,0xdc,0x11,0x85,0x97,0x19,0x6a,0x0b,0x32};
	
unsigned char key[16];
unsigned char data[16];
unsigned char expanded[176];


/*

PORTB - data

PORTA
	0 - start program
	1 - start timing
	2 - stop timing
	3 - compare OK
	4 - compare ERR
	5 - start function name
	6 - start property name
	7 - func value
	8 - global value

*/

#define COPY(to, from) memcpy(to, from, sizeof(to));

#define TIMERS(func) { PORTA = 1; func; PORTA = 2; }

#define COMPARE(x, y) comp((x), (y), sizeof(x))

void comp(const unsigned char* ptr1, const unsigned char* ptr2, int size)
{
	while (size--) {
		if (*ptr1++ != *ptr2++) {
			PORTA = 4;
			return;
		}
	}
	PORTA = 3;
}

#define NAME(x) { name(x, 5); }

void name(const char* name, unsigned char t)
{
	PORTA = t;
	while (1) {
		char p = *name++;
		if (!p) break;
		PORTB = p;
	}
}

#define GVALUE(name, x) sendValue(name, x, 8)
#define FVALUE(name, x) sendValue(name, x, 7)

void sendValue(const char* n, int v, unsigned char t)
{
	name(n, 6);
	PORTA = t;
	PORTB = v >> 8;
	PORTB = v;
}

int main(void)
{
	PORTA = 0;
	
	#if AES_IMPLEMENTATION == 0
	GVALUE("padding", 0);
	#else
	GVALUE("padding", 1);
	#endif

	#if AES_CIPHER
	NAME("aesCipher");
	COPY(data, plain);
	#if AES_IMPLEMENTATION <= 1
	COPY(key, K);
	TIMERS(aesCipher(key, data));
	COMPARE(key, IK);
	#else
	TIMERS(aesCipher(E, data));
	#endif
	COMPARE(data, cipher);
	#endif

	#if AES_INVCIPHER
	NAME("aesInvCipher");
	COPY(data, cipher);
	#if AES_IMPLEMENTATION <= 1
	COPY(key, IK);
	TIMERS(aesInvCipher(key, data));
	COMPARE(key, K);
	#elif AES_IMPLEMENTATION == 2
	TIMERS(aesInvCipher(E, data));
	#else
	TIMERS(aesInvCipher(EP, data));
	#endif
	COMPARE(data, plain);
	#endif

	#if AES_IMPLEMENTATION >= 2
	#if AES_KEYEXPAND 
	NAME("aesKeyExpand");
	TIMERS(aesKeyExpand(K, expanded));
	COMPARE(expanded, E);
	#endif
	#endif
	
	#if AES_IMPLEMENTATION != 2
	#if AES_KEYPATCH
	NAME("aesKeyPatch");
	#if AES_IMPLEMENTATION <= 1
	COPY(key, K);
	TIMERS(aesKeyPatch(key));
	COMPARE(key, IK);
	#else
	COPY(expanded, E);
	TIMERS(aesKeyPatch(expanded));
	COMPARE(expanded, EP);
	#endif
	#endif
	#endif
	
	#if AES_IMPLEMENTATION <= 1
	#if AES_KEYREWIND
	NAME("aesKeyRewind");
	COPY(key, IK);
	TIMERS(aesKeyRewind(key));
	COMPARE(key, K);
	#endif
	#endif	

	#if AES_IMPLEMENTATION <= 1
	GVALUE("user", sizeof(key) + sizeof(data));
	#else
	GVALUE("user", sizeof(E) + sizeof(data));
	#endif

	return 0;
}	
